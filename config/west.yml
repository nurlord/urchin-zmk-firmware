## config/west.yml
```yaml
manifest:
  remotes:
    # zmk official
    - name: zmkfirmware
      url-base: https://github.com/zmkfirmware
    # bravekarma
    - name: caksoylar
      url-base: https://github.com/caksoylar
    # nurlord
    - name: nurlord
      url-base: https://github.com/nurlord
  projects:
    - name: zmk
      remote: zmkfirmware
      revision: main
      import: app/west.yml
    - name: urchin-zmk-module
      remote: nurlord
      revision: main
  self:
    path: config
```
